// Puts the upper USB 3 port (dwc3_0) of the Radxa ROCK 4C+ in device mode,
// so it can be the car's drive. Only the mode changes: the port keeps its
// USB 2 and USB 3 PHYs, so it works with USB 2 hosts and cables too. (The
// overlay in the teslausb wiki also sets phys to the USB 3 PHY alone; a
// USB 2 connection then never shows up.)
/dts-v1/;
/plugin/;

/ {
	compatible = "rockchip,rk3399";

	fragment@0 {
		target = <&usbdrd_dwc3_0>;
		__overlay__ {
			dr_mode = "peripheral";
		};
	};
};
